## boards/shields/Atsukey/Kconfig.defconfig
```kconfig
if SHIELD_Atsukey_LEFT

# Name must be less than 16 characters long!
config ZMK_KEYBOARD_NAME
    default "Atsukey_LEFT"

config ZMK_SPLIT_ROLE_CENTRAL
    default y

endif

if SHIELD_Atsukey_LEFT || SHIELD_Atsukey_RIGHT

config ZMK_SPLIT
    default y

endif
```

## boards/shields/Atsukey/Kconfig.shield
```kconfig
config SHIELD_Atsukey_LEFT
    def_bool $(shields_list_contains,Atsukey_left)

config SHIELD_Atsukey_RIGHT
    def_bool $(shields_list_contains,Atsukey_right)
```

## boards/shields/atsukey/Kconfig.defconfig
```kconfig
if SHIELD_ATSUKEY_LEFT

config ZMK_KEYBOARD_NAME
    default "atsukey"

config ZMK_SPLIT
    default y

config ZMK_SPLIT_ROLE_CENTRAL
    default y

config ZMK_BLE
    default y

config ZMK_USB
    default y

endif

if SHIELD_ATSUKEY_RIGHT

config ZMK_KEYBOARD_NAME
    default "atsukey"

config ZMK_SPLIT
    default y

config ZMK_BLE
    default y

config ZMK_USB
    default n

endif
```

## boards/shields/atsukey/Kconfig.shield
```kconfig
config SHIELD_ATSUKEY_LEFT
    def_bool $(shields_list_contains,atsukey_left)

config SHIELD_ATSUKEY_RIGHT
    def_bool $(shields_list_contains,atsukey_right)
```

## config/west.yml
```yaml
manifest:
  remotes:
    - name: zmkfirmware
      url-base: https://github.com/zmkfirmware
    - name: fuku813-ui
      url-base: https://github.com/fuku813-ui
  projects:
    - name: zmk
      remote: zmkfirmware
      revision: main
      import: app/west.yml
  self:
    path: config
```
